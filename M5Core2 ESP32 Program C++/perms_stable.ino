#include <WiFi.h>
#include <M5Unified.h>
#include <TFT_eSPI.h>
#include "M5UnitENV.h"
SHT3X sht3x;
QMP6988 qmp;
WiFiClient client;
const unsigned long resetTime = 18000000; // refresh every 30 mins
unsigned long startTime;
const char* ssid     = "wifi-ssid";
const char* password = "wifi-password";
IPAddress local_IP(000, 00, 00, 000);
IPAddress subnet(000, 000, 000, 0);
IPAddress gateway(000, 00, 00, 000);
const char* devicename = "Devicename";
const char* host = "000.000.00.000"; // Client pc IP
const uint16_t port = 8080;
const unsigned char myBitmap [] PROGMEM = {
	0x00, 0x00, 0x00, 0x00, 0x00, 0x00, 0x00, 0x00, 0x00, 0x00, 0x00, 0x00, 0x00, 0x00, 0x00, 0x00, 
	0x00, 0x00, 0x00, 0x00, 0x00, 0x00, 0x00, 0x00, 0x00, 0x00, 0x00, 0x00, 0x00, 0x00, 0x00, 0x00, 
	0x00, 0x00, 0x00, 0x00, 0x00, 0x00, 0x00, 0x00, 0x00, 0x00, 0x00, 0x00, 0x00, 0x00, 0x00, 0x00, 
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	0x00, 0x00, 0x00, 0x00, 0x00, 0x00, 0x00, 0x00
};
const unsigned char batteryicon[] PROGMEM = {
  0x00, 0x00, 0x00, 0x00, 0x00, 0x00, 0x00, 0x00, 0x00, 0x00, 0x00, 0x00, 0x00, 0x00, 0x00, 0x00, 
	0x00, 0x00, 0x00, 0x00, 0x00, 0x03, 0xff, 0xff, 0xff, 0xff, 0xc0, 0x00, 0x0f, 0xff, 0xff, 0xff, 
	0xff, 0xf0, 0x00, 0x18, 0x00, 0x00, 0x00, 0x00, 0x18, 0x00, 0x13, 0xff, 0xff, 0xff, 0xff, 0x88, 
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	0x00, 0x00, 0x00, 0x00, 0x00, 0x00, 0x00, 0x00, 0x00, 0x00, 0x00, 0x00, 0x00, 0x00, 0x00
};

const unsigned char waterDropIcon[] PROGMEM = {
	0x00, 0x00, 0x00, 0x00, 0x00, 0x00, 0x00, 0x00, 0x00, 0x00, 0x00, 0x00, 0x00, 0x00, 0x00, 0x00, 
	0x00, 0x00, 0x00, 0x00, 0x00, 0x00, 0x00, 0x00, 0x00, 0x00, 0x00, 0x00, 0x00, 0x00, 0x00, 0x00, 
	0x00, 0x00, 0x00, 0x00, 0x00, 0x00, 0x00, 0x00, 0x00, 0x00, 0x00, 0x00, 0x00, 0x00, 0x00, 0x00, 
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	0x00, 0x00, 0x00, 0x00, 0x00, 0x00, 0x00, 0x00
};
void connectToWiFi() {
  Serial.print("Connecting to ");
  Serial.println(ssid);
  M5.Lcd.setCursor(10, 10);
  WiFi.config(local_IP, gateway, subnet);
  WiFi.begin(ssid, password);
  while (WiFi.status() != WL_CONNECTED) {
    delay(500);
    Serial.println("Reconnecting to Wifi.");
    M5.Lcd.fillCircle(10, 15, 7, RED); // Draw  circle
    WiFi.disconnect();
    WiFi.reconnect();
  }
  Serial.println("");
  Serial.println("WiFi connected.");
  Serial.print("IP address: ");
  Serial.println(WiFi.localIP());
  M5.Lcd.fillCircle(10, 15, 7, GREEN); // wifi indicator
  Serial.print("Connecting to host ");
  Serial.println(host);
  M5.Lcd.setCursor(10, 10);
  if (client.connect(host, port)) {
    Serial.println("Connected to host");
    M5.Lcd.setCursor(10, 10);
 } else {
    M5.Lcd.fillCircle(300, 30, 10, RED); // host indicator
    Serial.println("Connection to host failed");
    M5.Lcd.setCursor(10, 10);
  }
}
void setup() {

M5.begin();
M5.Lcd.setTextSize(2);
Serial.begin(115200);
startTime = millis();
connectToWiFi();
    if (!qmp.begin(&Wire, QMP6988_SLAVE_ADDRESS_L, 32, 33, 400000U)) {
        Serial.println("Couldn't find QMP6988");
        while (1) delay(1);
    }
    if (!sht3x.begin(&Wire, SHT3X_I2C_ADDR, 32, 33, 400000U)) {
        Serial.println("Couldn't find SHT3X");
        while (1) delay(1);
    }
}

void loop() {
 if (millis() - startTime >= resetTime) {
    ESP.restart(); // Reset the device
  }
 if (WiFi.status() != WL_CONNECTED) {
    Serial.println("Wifi Disconnected!.");
    connectToWiFi(); 
  } 
  if (!client.connected()) {
    Serial.println("Disconnected from host. Reconnecting...");
    if (client.connect(host, port)) {
      Serial.println("Reconnected to host");
      M5.Lcd.setCursor(10, 10);
      M5.Lcd.fillCircle(10, 35, 7, GREEN);
    } else {
      Serial.println("Failed to reconnect to host");
      M5.Lcd.setCursor(10, 10);
      M5.Lcd.fillCircle(10, 35, 7, RED);
    }
    delay(500);
    M5.Lcd.fillScreen(TFT_BLACK);
  }
    if (sht3x.update()) {
    float temperature = sht3x.cTemp;
    float humidity = sht3x.humidity;

      Serial.print("Temp:");
      Serial.println(sht3x.cTemp);
      Serial.print("Hum:");
      Serial.println(sht3x.humidity);


M5.Lcd.setCursor(10, 10);
M5.Lcd.print("  Wi-Fi:   ");
M5.Lcd.println(ssid);
M5.Lcd.print("   Host-IP: ");
M5.Lcd.println(host);
M5.Lcd.print("   My-IP:   ");
M5.Lcd.println(local_IP);
M5.Lcd.print("   My-ID:   ");
M5.Lcd.println(devicename);
M5.Lcd.println("==========================");
M5.Lcd.print("\n");

         
    // Display temperature icon and value
M5.Lcd.setTextSize(1.5);
M5.Lcd.setFreeFont(&FreeSans12pt7b);
M5.Lcd.print("         ");
M5.Lcd.print(temperature); 
M5.Lcd.println(" C");
M5.Lcd.print("         ");
M5.Lcd.drawBitmap(5, 95, waterDropIcon, 74, 100, CYAN);
M5.Lcd.print(humidity);
M5.Lcd.println(" %");
M5.Lcd.setFreeFont(NULL);
M5.Lcd.setTextSize(2); 

   int batteryPercentage = M5.Power.getBatteryLevel();
   bool isCharging = M5.Power.isCharging();
  // Display battery percentage
M5.Lcd.print("\n");
  

M5.Lcd.printf("     %d%%", batteryPercentage);
M5.Lcd.print("\n");
M5.Lcd.printf("Charging:%s", isCharging ? "Yes" : "No");

M5.Lcd.setFreeFont(&FreeSans12pt7b);
M5.Lcd.setTextSize(0.8);
M5.Lcd.print("       LSI-PES | AIM");
M5.Lcd.setFreeFont(NULL);
M5.Lcd.setTextSize(2); 

M5.Lcd.drawBitmap(5, 195, batteryicon, 50, 25, GREEN);
//M5.Lcd.drawBitmap(200, 80, luffy, 100, 100, CYAN);

M5.Lcd.drawBitmap(200, 80, myBitmap, 120, 120, WHITE);

M5.Lcd.fillCircle(10, 15, 7, GREEN);
M5.Lcd.fillCircle(10, 35, 7, GREEN);

 // Send temperature and humidity to the VB.NET application
    if (client.connected()) {
    client.println(String(devicename) + ", Temp:" + String(sht3x.cTemp) + ", Hum:" + String(sht3x.humidity));

    }
    }
 
    delay(1000);
}